## esp32/sdkconfig.defaults
```kconfig
CONFIG_IDF_TARGET="esp32"
CONFIG_ESPTOOLPY_FLASHSIZE_4MB=y
CONFIG_ESPTOOLPY_FLASHSIZE="4MB"
CONFIG_ESPTOOLPY_FLASHMODE_DIO=y
CONFIG_ESPTOOLPY_FLASHFREQ_40M=y
CONFIG_ESPTOOLPY_MONITOR_BAUD=115200
CONFIG_FREERTOS_HZ=1000
CONFIG_ESP_MAIN_TASK_STACK_SIZE=8192
CONFIG_NEWLIB_TIME_SYSCALL_USE_RTC_HRT=y
CONFIG_LWIP_SNTP_UPDATE_DELAY=3600000
CONFIG_MBEDTLS_CERTIFICATE_BUNDLE=n
CONFIG_BOOTLOADER_APP_ROLLBACK_ENABLE=n
CONFIG_COMPILER_OPTIMIZATION_SIZE=y
```
